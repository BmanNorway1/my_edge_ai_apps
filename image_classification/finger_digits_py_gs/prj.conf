## CMakeLists.txt
```
#
# Copyright (c) 2026 Nordic Semiconductor ASA
#
# SPDX-License-Identifier: LicenseRef-Nordic-5-Clause
#

cmake_minimum_required(VERSION 3.20.0)

find_package(Zephyr REQUIRED HINTS $ENV{ZEPHYR_BASE})
project(finger_digits)

list(APPEND DTS_ROOT ${CMAKE_CURRENT_SOURCE_DIR})

target_sources(app PRIVATE
  src/main.c
  src/drivers/arducam_mega.c
)

# Only built when Bluetooth is enabled in prj.conf; the ble_nus_*() calls in
# main.c become no-op stubs otherwise (see src/ble_nus.h).
target_sources_ifdef(CONFIG_BT app PRIVATE src/ble_nus.c)
```

## prj.conf
```kconfig
# Copyright (c) 2026 Nordic Semiconductor
# SPDX-License-Identifier: LicenseRef-Nordic-5-Clause

# Enable logging
CONFIG_PRINTK=y
CONFIG_LOG=y
CONFIG_LOG_MODE_IMMEDIATE=y
CONFIG_CBPRINTF_FP_SUPPORT=n
CONFIG_LOG_MODE_MINIMAL=y
CONFIG_RTT_CONSOLE=y

# Enable GPIO for LEDs
CONFIG_GPIO=y

# Enable Axon NPU driver and configure buffer
CONFIG_NRF_AXON=y
CONFIG_NRF_AXON_INTERLAYER_BUFFER_SIZE=153601

# Enable and configure Arducam dependencies
CONFIG_SPI=y
CONFIG_VIDEO=y
CONFIG_VIDEO_BUFFER_POOL_HEAP_SIZE=2200
CONFIG_VIDEO_BUFFER_POOL_NUM_MAX=2

# Other
CONFIG_ASSERT=n
CONFIG_MAIN_STACK_SIZE=2048

# --- Bluetooth LE + NUS ---
# TOGGLE: comment out this whole block (down to CONFIG_BT_MAX_CONN) to build
# without Bluetooth. Nothing else needs editing -- src/ble_nus.c is dropped
# from the build by CMakeLists.txt and the ble_nus_*() calls in main.c become
# no-op stubs (see src/ble_nus.h).
# Comment out the whole block, not just CONFIG_BT: the remaining lines would
# then be assignments to symbols with unmet dependencies, which Kconfig warns
# about and ignores.
#
# Enabled: game_receiver matches peripherals by advertised name, so
# CONFIG_BT_DEVICE_NAME must stay "Axon_Sensor" for this board to be found (see
# the peer table in applications/game_receiver/game_receiver/src/ble/ble_central.c).
CONFIG_BT=y
CONFIG_BT_PERIPHERAL=y
CONFIG_BT_NUS=y
CONFIG_BT_DEVICE_NAME="Axon_Sensor"   # whatever you want B to scan for
CONFIG_BT_MAX_CONN=1

# BLE host runs work here; the sample's default main workqueue is too small
CONFIG_SYSTEM_WORKQUEUE_STACK_SIZE=2048

# BLE host uses some kernel heap
CONFIG_HEAP_MEM_POOL_SIZE=2048
```

## src/main.c
```c
/*
 * Copyright (c) 2026 Nordic Semiconductor ASA
 *
 * SPDX-License-Identifier: LicenseRef-Nordic-5-Clause
 */

#include <stdint.h>
#include <stdio.h>
#include <string.h>
#include <assert.h>
#include <zephyr/device.h>
#include <zephyr/drivers/gpio.h>
#include <zephyr/drivers/video.h>
#include <zephyr/kernel.h>
#include <zephyr/logging/log.h>

#include <axon/nrf_axon_platform.h>
#include <drivers/axon/nrf_axon_driver.h>
#include <drivers/axon/nrf_axon_nn_infer.h>

#include "generated/nrf_axon_model_finger_digits_.h"  // your compiled model

#include "ble_nus.h"

LOG_MODULE_REGISTER(main);

#define CAM_WIDTH    96
#define CAM_HEIGHT   96
#define MODEL_WIDTH  96
#define MODEL_HEIGHT 96

#define NUM_CLASSES 7 //Finger digits 0-5 + unknown
#define CLASS_UNKNOWN 6

/* Consecutive identical predictions required before a digit is reported to the
 * central. At one capture per 500 ms this is ~2.5 s of holding the same pose,
 * which filters out the noisy frames while the hand is moving into place. */
#define STABLE_PREDICTIONS_REQUIRED 5

#define FRAME_RGB565_BYTES ((CAM_WIDTH) * (CAM_HEIGHT) * 2)

/* MUST match the data-collection firmware. AE/AGC needs time to settle; if
 * training frames are captured after N warmup frames but inference reads
 * frame 0, the two see different brightness -> train/serve mismatch.
 * The stream is start/stopped every capture here, so AE resets each time and
 * warmup matters just as much as it does during collection. Keep these equal. */
#define WARMUP_FRAMES 8

static const char * const finger_digit_labels[] = {
    "zero", "one", "two", "three", "four", "five", "unknown"
};

/* Wire tokens, in the same format game_controller uses for the snake commands:
 * one short uppercase ASCII token per command, CRLF-terminated, so that
 * game_receiver relays each one as a "Command: <token>" console line and the
 * host-side parser needs no new framing. "unknown" is never sent, hence NULL. */
static const char * const finger_digit_commands[] = {
    "ZERO\r\n", "ONE\r\n", "TWO\r\n", "THREE\r\n", "FOUR\r\n", "FIVE\r\n", NULL
};

BUILD_ASSERT(ARRAY_SIZE(finger_digit_commands) == NUM_CLASSES,
             "Mismatch between finger_digit_commands and NUM_CLASSES");
BUILD_ASSERT(ARRAY_SIZE(finger_digit_labels) == NUM_CLASSES,
             "Mismatch between finger_digit_labels and NUM_CLASSES");

/* Single-channel (grayscale) model input, input_shape=(H, W, 1).
 * NOTE: the pixels fed here are continuous grayscale (0..255 domain), NOT
 * binarized. The model MUST be retrained on grayscale images produced by the
 * exact same rgb565_to_gray() arithmetic used in the collection firmware. */
static int8_t input_buf[MODEL_WIDTH * MODEL_HEIGHT];
static int8_t output_buf[NUM_CLASSES];
static uint8_t gray_buf[MODEL_WIDTH * MODEL_HEIGHT];

/* Prediction debounce state. A digit is reported once its run of identical
 * predictions reaches STABLE_PREDICTIONS_REQUIRED, and not again until the
 * prediction changes -- so holding one pose emits exactly one command, and
 * showing the same digit twice means dropping the hand in between. */
static int stable_idx = -1;
static int stable_streak;
static bool stable_reported;

static const struct gpio_dt_spec led_connected = GPIO_DT_SPEC_GET(DT_ALIAS(led0), gpios);

static void capture_timer_expiry(struct k_timer *timer);
static K_TIMER_DEFINE(capture_timer, capture_timer_expiry, NULL);
static K_SEM_DEFINE(capture_sem, 0, 1);

static void capture_timer_expiry(struct k_timer *timer)
{
    k_sem_give(&capture_sem);
}

static inline int8_t quantize(const float value, const nrf_axon_nn_compiled_model_input_s *in)
{
    const uint32_t quant_mult = in->quant_mult;
    const uint8_t quant_round = in->quant_round;
    const int8_t quant_zp = in->quant_zp;

    const float scale = (float)quant_mult / (float)(1 << quant_round);
    const int32_t quantized = (int32_t)(value * scale) + quant_zp;

    return (int8_t)__ssat(quantized, 8);
}

/*=============================== GRAYSCALE LUT ================================*/
static int8_t gray_lut[256];

static void init_gray_lut(const nrf_axon_nn_compiled_model_input_s *in)
{
    for (int v = 0; v < 256; v++) {
        gray_lut[v] = quantize((float)v, in);
    }
    LOG_INF("Gray LUT: [0]=%d [128]=%d [255]=%d",
            gray_lut[0], gray_lut[128], gray_lut[255]);
}
/*==============================================================================*/


static int led_init(const struct gpio_dt_spec *spec)
{
    int err;

    if (!gpio_is_ready_dt(spec)) {
        LOG_ERR("GPIO %s is not ready", spec->port->name);
        return -ENODEV;
    }

    err = gpio_pin_configure_dt(spec, GPIO_OUTPUT_INACTIVE);
    if (err) {
        LOG_ERR("Failed to configure %s pin %u (err %d)", spec->port->name, spec->pin, err);
        return err;
    }

    return 0;
}

/*============================ SHARED GRAYSCALE ================================
 * These two functions MUST be byte-for-byte identical to the data-collection
 * firmware, so the pixels the model sees at inference equal the pixels it was
 * trained on, exactly.
 *===========================================================================*/

static inline uint16_t extract_pixel(const uint8_t *data, const size_t pixel)
{
    const size_t offset = pixel * 2;

    return (uint16_t)((uint16_t)data[offset] << 8 | data[offset + 1]);
}

static inline uint8_t rgb565_to_gray(const uint16_t pixel)
{
    const uint8_t r5 = (pixel >> 11) & 0x1f;
    const uint8_t g6 = (pixel >> 5) & 0x3f;
    const uint8_t b5 = pixel & 0x1f;

    const uint8_t r = (r5 * 255) / 31;
    const uint8_t g = (g6 * 255) / 63;
    const uint8_t b = (b5 * 255) / 31;

    return (uint8_t)((r * 77 + g * 150 + b * 29) >> 8);
}

static void convert_chunk_to_model_input(const uint8_t *chunk_buf, const size_t pixel_start,
                                         const size_t pixel_count)
{
    for (size_t p = 0; p < pixel_count; p++) {
        /* CAM_WIDTH/HEIGHT == MODEL_WIDTH/HEIGHT, so pixels map 1:1 */
        gray_buf[pixel_start + p] = rgb565_to_gray(extract_pixel(chunk_buf, p));
    }
}
/*===========================================================================*/

static int capture_one_frame(const struct device *video)
{
    size_t total = 0;

    while (total < FRAME_RGB565_BYTES) {
        struct video_buffer *vbuf;
        int err = video_dequeue(video, &vbuf, K_FOREVER);

        if (err == -EAGAIN) {
            continue;
        }
        if (err) {
            LOG_ERR("video_dequeue failed: %d", err);
            return err;
        }

        const size_t room = FRAME_RGB565_BYTES - total;
        const size_t chunk = MIN(vbuf->bytesused, room);

        convert_chunk_to_model_input(vbuf->buffer, total / 2, chunk / 2);

        total += chunk;

        vbuf->type = VIDEO_BUF_TYPE_OUTPUT;
        video_enqueue(video, vbuf);
    }

    /* Grayscale -> quantized int8 via LUT (was: mean threshold to binary) */
    for (size_t i = 0; i < MODEL_WIDTH * MODEL_HEIGHT; i++) {
        input_buf[i] = gray_lut[gray_buf[i]];
    }

    return 0;
}

/* Feed one prediction into the debounce filter and, when it settles on a digit,
 * push the matching command to the central over NUS. */
static void report_prediction(const int class_idx)
{
    if (class_idx != stable_idx) {
        stable_idx = class_idx;
        stable_streak = 1;
        stable_reported = false;
    } else if (stable_streak < STABLE_PREDICTIONS_REQUIRED) {
        stable_streak++;
    }

    if (stable_reported || stable_streak < STABLE_PREDICTIONS_REQUIRED ||
        class_idx == CLASS_UNKNOWN) {
        return;
    }

    const char *cmd = finger_digit_commands[class_idx];
    int err = ble_nus_send(cmd, (uint16_t)strlen(cmd));

    if (err) {
        /* Not connected yet, or the stack pushed back. Stay unlatched so the
         * next frame of this same streak retries. */
        LOG_WRN("NUS send failed (err %d)", err);
        return;
    }

    stable_reported = true;
    LOG_INF("Sent command: %s", finger_digit_labels[class_idx]);
}

static int capture_and_classify(const struct device *video,
                                const nrf_axon_nn_compiled_model_s *model)
{
    int err;
    nrf_axon_result_e result;

    err = video_stream_start(video, VIDEO_BUF_TYPE_OUTPUT);
    if (err) {
        LOG_ERR("Failed to start stream (err %d)", err);
        return -1;
    }

    /* Discard warmup frames so AE/AGC settles -- matches the collection
     * firmware, otherwise inference frames are brighter/darker than every
     * training image. */
    for (int i = 0; i < WARMUP_FRAMES; i++) {
        err = capture_one_frame(video);
        if (err) {
            LOG_ERR("Warmup frame failed (err %d)", err);
            (void)video_stream_stop(video, VIDEO_BUF_TYPE_OUTPUT);
            return -1;
        }
    }

    err = capture_one_frame(video);
    if (err) {
        LOG_ERR("Failed to capture frame (err %d)", err);
        (void)video_stream_stop(video, VIDEO_BUF_TYPE_OUTPUT);
        return -1;
    }

    err = video_stream_stop(video, VIDEO_BUF_TYPE_OUTPUT);
    if (err) {
        LOG_ERR("Failed to stop stream (err %d)", err);
        return -1;
    }

    result = nrf_axon_nn_model_infer_sync(model, input_buf, output_buf);
    if (result != NRF_AXON_RESULT_SUCCESS) {
        LOG_ERR("Inference failed (result %d)", result);
        return -1;
    }

    // Find the class with the highest score
    int8_t max_val = output_buf[0];
    int max_idx = 0;

    for (int i = 1; i < NUM_CLASSES; i++) {
        if (output_buf[i] > max_val) {
            max_val = output_buf[i];
            max_idx = i;
        }
    }

    // Calculate the score as a percentage based on the quantization parameters
    float max_score = (((float)max_val - model_finger_digits.output_dequant_zp)/256) * 100;
    LOG_INF("Detected finger digit: %s (score %d)", finger_digit_labels[max_idx], (int)max_score);

    report_prediction(max_idx);

    return 0;
}

int main(void)
{
    int err;
    nrf_axon_result_e result;

    const nrf_axon_nn_compiled_model_s *model = &model_finger_digits;
    const nrf_axon_nn_compiled_model_input_s *model_inputs =
        nrf_axon_nn_model_1st_external_input(model);

    const struct device *video = DEVICE_DT_GET(DT_NODELABEL(arducam_mega));
    struct video_buffer *vbufs[2];
    struct video_format fmt = {.type = VIDEO_BUF_TYPE_INPUT,
                               .pixelformat = VIDEO_PIX_FMT_RGB565,
                               .width = CAM_WIDTH,
                               .height = CAM_HEIGHT,
                               .pitch = CAM_WIDTH * 2};

    if (led_init(&led_connected) != 0) {
        return -1;
    }

    if (!device_is_ready(video)) {
        LOG_ERR("Video device not ready");
        return -1;
    }

    err = video_set_format(video, &fmt);
    if (err) {
        LOG_ERR("Setting video format failed (err %d)", err);
        return -1;
    }

    for (size_t i = 0; i < ARRAY_SIZE(vbufs); i++) {
        vbufs[i] = video_buffer_alloc(1024, K_NO_WAIT);
        if (vbufs[i] == NULL) {
            LOG_ERR("Allocation failed for video buffer %u", i);
            return -1;
        }
        vbufs[i]->type = VIDEO_BUF_TYPE_OUTPUT;
        video_enqueue(video, vbufs[i]);
    }

    result = nrf_axon_platform_init();
    if (result != NRF_AXON_RESULT_SUCCESS) {
        LOG_ERR("Axon platform init failed (result %d)", result);
        return -1;
    }

    result = nrf_axon_nn_model_validate(model);
    if (result != NRF_AXON_RESULT_SUCCESS) {
        LOG_ERR("Model validation failed (result %d)", result);
        return -1;
    }

    init_gray_lut(model_inputs);


    err = init_ble_nus(&led_connected);
    if (err) {
        LOG_ERR("BLE init failed (err %d)", err);
        return -1;
    }

    LOG_INF("Finger digit classifier start");

    k_timer_start(&capture_timer, K_NO_WAIT, K_MSEC(500));

    while (true) {
        err = k_sem_take(&capture_sem, K_FOREVER);
        if (err) {
            continue;
        }

        err = capture_and_classify(video, model);
        if (err) {
            return -1;
        }
    }

    return 0;
}
```

## src/ble_nus.c
```c
/*
 * Copyright (c) 2026
 * SPDX-License-Identifier: LicenseRef-Nordic-5-Clause
 *
 * Minimal Nordic UART Service (NUS) peripheral module.
 * Sender side only: advertises, accepts one connection, and pushes
 * application data out as TX-characteristic notifications.
 *
 * Derived from the peripheral_uart sample, with the UART bridge,
 * bonding/security, and DK LED/button code removed.
 */

#include <zephyr/kernel.h>
#include <errno.h>

#include <zephyr/bluetooth/bluetooth.h>
#include <zephyr/bluetooth/conn.h>
#include <zephyr/bluetooth/uuid.h>

#include <bluetooth/services/nus.h>

#include <zephyr/logging/log.h>

#include "ble_nus.h"

LOG_MODULE_REGISTER(ble_nus, LOG_LEVEL_INF);

#define DEVICE_NAME     CONFIG_BT_DEVICE_NAME
#define DEVICE_NAME_LEN (sizeof(DEVICE_NAME) - 1)

/* Written from the BT RX thread (callbacks), read from the app thread.
 * Word-sized single-writer access is fine for test purposes; promote to
 * atomics if you ever add a second connection or a second writer.
 */
static struct bt_conn *current_conn;
static volatile bool notify_enabled;

static struct k_work adv_work;

/* Advertising payload: flags + full local name.
 * Scan-response carries the NUS UUID, which is what central_uart filters on.
 */
static const struct bt_data ad[] = {
	BT_DATA_BYTES(BT_DATA_FLAGS, (BT_LE_AD_GENERAL | BT_LE_AD_NO_BREDR)),
	BT_DATA(BT_DATA_NAME_COMPLETE, DEVICE_NAME, DEVICE_NAME_LEN),
};

static const struct bt_data sd[] = {
	BT_DATA_BYTES(BT_DATA_UUID128_ALL, BT_UUID_NUS_VAL),
};

static void adv_work_handler(struct k_work *work)
{
	int err = bt_le_adv_start(BT_LE_ADV_CONN_FAST_2, ad, ARRAY_SIZE(ad),
				  sd, ARRAY_SIZE(sd));
	if (err) {
		LOG_ERR("Advertising failed to start (err %d)", err);
		return;
	}

	LOG_INF("Advertising started as \"%s\"", DEVICE_NAME);
}

static void advertising_start(void)
{
	k_work_submit(&adv_work);
}

static void connected(struct bt_conn *conn, uint8_t err)
{
	char addr[BT_ADDR_LE_STR_LEN];

	if (err) {
		LOG_ERR("Connection failed (err 0x%02x)", err);
		return;
	}

	bt_addr_le_to_str(bt_conn_get_dst(conn), addr, sizeof(addr));
	LOG_INF("Connected %s", addr);

	current_conn = bt_conn_ref(conn);
}

static void disconnected(struct bt_conn *conn, uint8_t reason)
{
	char addr[BT_ADDR_LE_STR_LEN];

	bt_addr_le_to_str(bt_conn_get_dst(conn), addr, sizeof(addr));
	LOG_INF("Disconnected: %s (reason 0x%02x)", addr, reason);

	notify_enabled = false;

	if (current_conn) {
		bt_conn_unref(current_conn);
		current_conn = NULL;
	}
}

/* Called once the disconnected connection object is fully released.
 * Restart advertising here so the sensor becomes discoverable again.
 */
static void recycled_cb(void)
{
	advertising_start();
}

BT_CONN_CB_DEFINE(conn_callbacks) = {
	.connected    = connected,
	.disconnected = disconnected,
	.recycled     = recycled_cb,
};

/* Fires when the central subscribes/unsubscribes to TX notifications.
 * This is the real "ready to receive" signal, not just being connected.
 */
static void nus_send_enabled_cb(enum bt_nus_send_status status)
{
	notify_enabled = (status == BT_NUS_SEND_STATUS_ENABLED);
	LOG_INF("NUS notifications %s", notify_enabled ? "enabled" : "disabled");
}

static struct bt_nus_cb nus_cb = {
	.send_enabled = nus_send_enabled_cb,
	/* .received intentionally omitted: this node only sends. */
};

int init_ble_nus(void)
{
	int err;

	k_work_init(&adv_work, adv_work_handler);

	err = bt_enable(NULL);
	if (err) {
		LOG_ERR("bt_enable failed (err %d)", err);
		return err;
	}
	LOG_INF("Bluetooth initialized");

	err = bt_nus_init(&nus_cb);
	if (err) {
		LOG_ERR("bt_nus_init failed (err %d)", err);
		return err;
	}

	advertising_start();
	return 0;
}

bool ble_nus_ready(void)
{
	return (current_conn != NULL) && notify_enabled;
}

int ble_nus_send(const void *data, uint16_t len)
{
	if (!ble_nus_ready()) {
		return -ENOTCONN;
	}

	return bt_nus_send(current_conn, (const uint8_t *)data, len);
}
```

## src/ble_nus.h
```c
/*
 * Copyright (c) 2026
 * SPDX-License-Identifier: LicenseRef-Nordic-5-Clause
 *
 * Nordic UART Service (NUS) sender interface.
 *
 * The whole module compiles out when Bluetooth is disabled in prj.conf:
 * src/ble_nus.c is dropped from the build (see CMakeLists.txt) and the calls
 * below collapse into no-op stubs. Callers therefore need no #ifdefs of their
 * own -- main.c builds unchanged either way.
 */

#ifndef __BLE_NUS_H__
#define __BLE_NUS_H__

#include <zephyr/kernel.h>
#include <zephyr/drivers/gpio.h>
#include <errno.h>

#ifdef __cplusplus
extern "C" {
#endif

#ifdef CONFIG_BT

int init_ble_nus(const struct gpio_dt_spec *led);
bool ble_nus_ready(void);
int ble_nus_send(const void *data, uint16_t len);

#else /* !CONFIG_BT -- BLE disabled, stub the interface out */

/* Signatures must track the CONFIG_BT declarations above exactly: main.c is
 * compiled against whichever branch is active, so a stub that drifts only breaks
 * the build in the configuration nobody happens to be building.
 */
static inline int init_ble_nus(const struct gpio_dt_spec *led)
{
	ARG_UNUSED(led);
	return 0;
}

static inline bool ble_nus_ready(void)
{
	return false;
}

static inline int ble_nus_send(const void *data, uint16_t len)
{
	ARG_UNUSED(data);
	ARG_UNUSED(len);
	return -ENOTSUP;
}

#endif /* CONFIG_BT */

#ifdef __cplusplus
}
#endif

#endif /* __BLE_NUS_H__ */
```
