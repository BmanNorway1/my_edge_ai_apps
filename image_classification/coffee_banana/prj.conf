## CMakeLists.txt
```
#
# Copyright (c) 2026 Nordic Semiconductor ASA
#
# SPDX-License-Identifier: LicenseRef-Nordic-5-Clause
#

cmake_minimum_required(VERSION 3.20.0)

set(EXTRA_CONF_FILE
    ./ei-model/conf_overlay.conf
)

find_package(Zephyr REQUIRED HINTS $ENV{ZEPHYR_BASE})
project(coffee_banana)
list(APPEND DTS_ROOT ${CMAKE_CURRENT_SOURCE_DIR})

target_include_directories(app PRIVATE ei-model)
zephyr_include_directories(ei-model/nordic-axon-model)

target_sources(app PRIVATE
    src/main.c
    src/drivers/arducam_mega.c
)
```

## prj.conf
```kconfig
# Copyright (c) 2026 Nordic Semiconductor
# SPDX-License-Identifier: LicenseRef-Nordic-5-Clause

# Enable logging
CONFIG_PRINTK=y
CONFIG_LOG=y
CONFIG_LOG_MODE_IMMEDIATE=y
CONFIG_CBPRINTF_FP_SUPPORT=y
CONFIG_LOG_BUFFER_SIZE=4096
CONFIG_RTT_CONSOLE=y

# Enable GPIO for LEDs
CONFIG_GPIO=y

# Enable Axon NPU driver and configure buffer
CONFIG_NRF_AXON=y
CONFIG_NRF_AXON_INTERLAYER_BUFFER_SIZE=110593

# Enable and configure Arducam dependencies
CONFIG_SPI=y
CONFIG_VIDEO=y
CONFIG_VIDEO_BUFFER_POOL_HEAP_SIZE=2200
CONFIG_VIDEO_BUFFER_POOL_NUM_MAX=4

# Other
CONFIG_ASSERT=y
CONFIG_MAIN_STACK_SIZE=2048

CONFIG_EDGE_IMPULSE_SDK=y
CONFIG_CPP=y
CONFIG_STD_CPP11=y
CONFIG_REQUIRES_FULL_LIBCPP=y
```

## src/main.c
```c
/*
 * Copyright (c) 2026 Nordic Semiconductor ASA
 *
 * SPDX-License-Identifier: LicenseRef-Nordic-5-Clause
 */

#include <stdint.h>
#include <assert.h>
#include <zephyr/device.h>
#include <zephyr/drivers/gpio.h>
#include <zephyr/drivers/video.h>
#include <zephyr/kernel.h>
#include <zephyr/logging/log.h>

#include <axon/nrf_axon_platform.h>
#include <drivers/axon/nrf_axon_driver.h>
#include <drivers/axon/nrf_axon_nn_infer.h>

#include <nrf_axon_model_coffee_cup_vs_banana_9_.h>  // your compiled model

LOG_MODULE_REGISTER(main);

#define CAM_WIDTH    96
#define CAM_HEIGHT   96
#define MODEL_WIDTH  96
#define MODEL_HEIGHT 96
#define PAD_LEFT     (((MODEL_WIDTH) - (CAM_WIDTH)) / 2)
#define PAD_TOP	     (((MODEL_HEIGHT) - (CAM_HEIGHT)) / 2)

#define NUM_CLASSES 3 // Coffee and banana + unknown 

#define FRAME_RGB565_BYTES ((CAM_WIDTH) * (CAM_HEIGHT) * 2)

#define LUT_SIZE_5_BITS 32
#define LUT_SIZE_6_BITS 64

#define WARMUP_FRAMES 5

static const char *coffee_or_banana[] = {
    "Banana", "Coffee cup", "Unknown"
};

static int8_t input_buf[MODEL_WIDTH * MODEL_HEIGHT * 3];
static int8_t output_buf[NUM_CLASSES];

static int8_t lut_red_blue[LUT_SIZE_5_BITS];
static int8_t lut_green[LUT_SIZE_6_BITS];

static const struct gpio_dt_spec led_capture = GPIO_DT_SPEC_GET(DT_ALIAS(led0), gpios);
static const struct gpio_dt_spec led_detection = GPIO_DT_SPEC_GET(DT_ALIAS(led1), gpios);

static void capture_timer_expiry(struct k_timer *timer);
static K_TIMER_DEFINE(capture_timer, capture_timer_expiry, NULL);
static K_SEM_DEFINE(capture_sem, 0, 1);

static void capture_timer_expiry(struct k_timer *timer)
{
    k_sem_give(&capture_sem);
}

static int led_init(const struct gpio_dt_spec *spec)
{
    int err;

    if (!gpio_is_ready_dt(spec)) {
        LOG_ERR("GPIO %s is not ready", spec->port->name);
        return -ENODEV;
    }

    err = gpio_pin_configure_dt(spec, GPIO_OUTPUT_INACTIVE);
    if (err) {
        LOG_ERR("Failed to configure %s pin %u (err %d)", spec->port->name, spec->pin, err);
        return err;
    }

    return 0;
}

static inline int8_t quantize(const float value, const nrf_axon_nn_compiled_model_input_s *in)
{
    const uint32_t quant_mult = in->quant_mult;
    const uint8_t quant_round = in->quant_round;
    const int8_t quant_zp = in->quant_zp;

    const float scale = (float)quant_mult / (float)(1 << quant_round);
    const int32_t quantized = (int32_t)(value * scale) + quant_zp;

    return (int8_t)__ssat(quantized, 8);
}

static void prefill_input_buf(const nrf_axon_nn_compiled_model_input_s *in)
{
    const float gray_symmetric = 0.0f;
    const int8_t gray = quantize(gray_symmetric, in);

    memset(input_buf, gray, sizeof(input_buf));
}

static void prefill_luts(const nrf_axon_nn_compiled_model_input_s *in)
{
    for (size_t i = 0; i < ARRAY_SIZE(lut_red_blue); i++) {
        const float value = (float)i / 31.f; // 0.0 to 1.0 - NO symmetry conversion
        lut_red_blue[i] = quantize(value, in);
    }

    for (size_t i = 0; i < ARRAY_SIZE(lut_green); i++) {
        const float value = (float)i / 63.f; // 0.0 to 1.0 - NO symmetry conversion
        lut_green[i] = quantize(value, in);
    }
}

static inline uint16_t extract_pixel(const uint8_t *data, const size_t pixel)
{
    const size_t offset = pixel * 2;

    return (uint16_t)((uint16_t)data[offset] << 8 | data[offset + 1]);
}

static void convert_chunk_to_model_input(const uint8_t *chunk_buf, const size_t pixel_start,
					 const size_t pixel_count)
{
	for (size_t p = 0; p < pixel_count; p++) {
		const size_t pixel_idx = pixel_start + p;
		const size_t cam_row = pixel_idx / CAM_WIDTH;
		const size_t cam_col = pixel_idx % CAM_WIDTH;
		const size_t model_row = PAD_TOP + cam_row;
		const size_t model_col = PAD_LEFT + cam_col;
		const size_t dst_offset = model_row * MODEL_WIDTH + model_col;

		const uint16_t pixel = extract_pixel(chunk_buf, p);
		const uint8_t r5 = (pixel >> 11) & 0x1f;
		const uint8_t g6 = (pixel >> 5) & 0x3f;
		const uint8_t b5 = pixel & 0x1f;

		input_buf[0 * MODEL_WIDTH * MODEL_HEIGHT + dst_offset] = (int8_t)lut_red_blue[r5];
		input_buf[1 * MODEL_WIDTH * MODEL_HEIGHT + dst_offset] = (int8_t)lut_green[g6];
		input_buf[2 * MODEL_WIDTH * MODEL_HEIGHT + dst_offset] = (int8_t)lut_red_blue[b5];
	}
}
/*
static void convert_chunk_to_model_input(const uint8_t *chunk_buf, const size_t pixel_start,
                                         const size_t pixel_count)
{
    for (size_t p = 0; p < pixel_count; p++) {
        const size_t pixel_idx = pixel_start + p;
        const size_t cam_row = pixel_idx / CAM_WIDTH;
        const size_t cam_col = pixel_idx % CAM_WIDTH;
        const size_t model_row = PAD_TOP + cam_row;
        const size_t model_col = PAD_LEFT + cam_col;
        const size_t dst_offset = (model_row * MODEL_WIDTH + model_col) * 3; // HWC

        const uint16_t pixel = extract_pixel(chunk_buf, p);
        const uint8_t r5 = (pixel >> 11) & 0x1f;
        const uint8_t g6 = (pixel >> 5) & 0x3f;
        const uint8_t b5 = pixel & 0x1f;

        input_buf[dst_offset + 0] = lut_red_blue[r5]; // R
        input_buf[dst_offset + 1] = lut_green[g6];    // G
        input_buf[dst_offset + 2] = lut_red_blue[b5]; // B
    }
}
    */

static int capture_one_frame(const struct device *video)
{
    size_t total = 0;

    while (total < FRAME_RGB565_BYTES) {
        struct video_buffer *vbuf;
        int err = video_dequeue(video, &vbuf, K_FOREVER);

        if (err == -EAGAIN) {
            continue;
        }
        if (err) {
            LOG_ERR("video_dequeue failed: %d", err);
            return err;
        }

        const size_t room = FRAME_RGB565_BYTES - total;
        const size_t chunk = min(vbuf->bytesused, room);

        convert_chunk_to_model_input(vbuf->buffer, total / 2, chunk / 2);

        total += chunk;

        vbuf->type = VIDEO_BUF_TYPE_OUTPUT;
        video_enqueue(video, vbuf);
    }
 
    return 0;
}

static int capture_and_classify(const struct device *video,
                                const nrf_axon_nn_compiled_model_s *model)
{
    int err;
    nrf_axon_result_e result;

    (void)gpio_pin_toggle_dt(&led_capture);

    err = video_stream_start(video, VIDEO_BUF_TYPE_OUTPUT);
    if (err) {
        LOG_ERR("Failed to start stream (err %d)", err);
        return -1;
    }

    // Discard warmup frames so auto-exposure can settle
    for (int i = 0; i < WARMUP_FRAMES; i++) {
        err = capture_one_frame(video);
        if (err) {
            LOG_ERR("Warmup frame %d failed (err %d)", i, err);
            (void)video_stream_stop(video, VIDEO_BUF_TYPE_OUTPUT);
            return -1;
        }
    }

    // Capture the actual frame for inference
    err = capture_one_frame(video);
    if (err) {
        LOG_ERR("Failed to capture frame (err %d)", err);
        (void)video_stream_stop(video, VIDEO_BUF_TYPE_OUTPUT);
        return -1;
    }

    err = video_stream_stop(video, VIDEO_BUF_TYPE_OUTPUT);
    if (err) {
        LOG_ERR("Failed to stop stream (err %d)", err);
        return -1;
    }

    result = nrf_axon_nn_model_infer_sync(model, input_buf, output_buf);
    if (result != NRF_AXON_RESULT_SUCCESS) {
        LOG_ERR("Inference failed (result %d)", result);
        return -1;
    }

    LOG_INF("Raw scores - banana: %d, coffee: %d, unknown: %d",
        output_buf[0], output_buf[1], output_buf[2]);

    int8_t max_val = output_buf[0];
    int max_idx = 0;

    for (int i = 1; i < NUM_CLASSES; i++) {
        if (output_buf[i] > max_val) {
            max_val = output_buf[i];
            max_idx = i;
        }
    }

    LOG_INF("Detected: %s (score %d)", coffee_or_banana[max_idx], max_val);
    (void)gpio_pin_set_dt(&led_detection, max_idx != 2 ? 1 : 0);

    return 0;
}

int main(void)
{
    int err;
    nrf_axon_result_e result;

    const nrf_axon_nn_compiled_model_s *model = &model_coffee_cup_vs_banana_9;
    const nrf_axon_nn_compiled_model_input_s *model_inputs =
        nrf_axon_nn_model_1st_external_input(model);

    const struct device *video = DEVICE_DT_GET(DT_NODELABEL(arducam_mega));
    struct video_buffer *vbufs[2];
    struct video_format fmt = {.type = VIDEO_BUF_TYPE_INPUT,
                               .pixelformat = VIDEO_PIX_FMT_RGB565,
                               .width = CAM_WIDTH,
                               .height = CAM_HEIGHT,
                               .pitch = CAM_WIDTH * 2};

    if (led_init(&led_capture) != 0) {
        return -1;
    }
    if (led_init(&led_detection) != 0) {
        return -1;
    }

    if (!device_is_ready(video)) {
        LOG_ERR("Video device not ready");
        return -1;
    }

    err = video_set_format(video, &fmt);
    if (err) {
        LOG_ERR("Setting video format failed (err %d)", err);
        return -1;
    }

    for (size_t i = 0; i < ARRAY_SIZE(vbufs); i++) {
        vbufs[i] = video_buffer_alloc(1024, K_NO_WAIT);
        if (vbufs[i] == NULL) {
            LOG_ERR("Allocation failed for video buffer %u", i);
            return -1;
        }
        vbufs[i]->type = VIDEO_BUF_TYPE_OUTPUT;
        video_enqueue(video, vbufs[i]);
    }

    result = nrf_axon_platform_init();
    if (result != NRF_AXON_RESULT_SUCCESS) {
        LOG_ERR("Axon platform init failed (result %d)", result);
        return -1;
    }

    result = nrf_axon_nn_model_validate(model);
    if (result != NRF_AXON_RESULT_SUCCESS) {
        LOG_ERR("Model validation failed (result %d)", result);
        return -1;
    }

    prefill_input_buf(model_inputs);
    prefill_luts(model_inputs);

    LOG_INF("Finger digit classifier start");

    k_timer_start(&capture_timer, K_NO_WAIT, K_MSEC(500));

    while (true) {
        err = k_sem_take(&capture_sem, K_FOREVER);
        if (err) {
            continue;
        }

        err = capture_and_classify(video, model);
        if (err) { 
            return -1;
        }
    }

    return 0;
}
```
