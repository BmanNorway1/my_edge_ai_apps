## CMakeLists.txt
```
#
# Copyright (c) 2026 Nordic Semiconductor ASA
#
# SPDX-License-Identifier: LicenseRef-Nordic-5-Clause
#

cmake_minimum_required(VERSION 3.20.0)

find_package(Zephyr REQUIRED HINTS $ENV{ZEPHYR_BASE})
project(cifar10)

list(APPEND DTS_ROOT ${CMAKE_CURRENT_SOURCE_DIR})

target_include_directories(app PRIVATE ${CMAKE_CURRENT_SOURCE_DIR}/src)

target_sources(app PRIVATE
  src/main.c
  src/drivers/arducam_mega.c

)
```

## prj.conf
```kconfig
# Copyright (c) 2026 Nordic Semiconductor
# SPDX-License-Identifier: LicenseRef-Nordic-5-Clause

# Enable logging
CONFIG_PRINTK=y
CONFIG_LOG=y
CONFIG_LOG_MODE_IMMEDIATE=y
CONFIG_CBPRINTF_FP_SUPPORT=n
CONFIG_LOG_MODE_MINIMAL=y
CONFIG_RTT_CONSOLE=y

# Enable GPIO for LEDs
CONFIG_GPIO=y

# Enable Axon NPU driver and configure buffer
CONFIG_NRF_AXON=y
CONFIG_NRF_AXON_INTERLAYER_BUFFER_SIZE=82945

# Enable and configure Arducam dependencies
CONFIG_SPI=y
CONFIG_VIDEO=y
CONFIG_VIDEO_BUFFER_POOL_HEAP_SIZE=2200
CONFIG_VIDEO_BUFFER_POOL_NUM_MAX=2

# Other
CONFIG_ASSERT=n
CONFIG_MAIN_STACK_SIZE=1024
```

## src/main.c
```c
#include <stdint.h>
#include <assert.h>
#include <zephyr/device.h>
#include <zephyr/drivers/gpio.h>
#include <zephyr/drivers/video.h>
#include <zephyr/kernel.h>
#include <zephyr/logging/log.h>

#include <axon/nrf_axon_platform.h>
#include <drivers/axon/nrf_axon_driver.h>
#include <drivers/axon/nrf_axon_nn_infer.h>

#include <generated/nrf_axon_model_cifar10_model_.h> 

LOG_MODULE_REGISTER(main);

#define CAM_WIDTH    96
#define CAM_HEIGHT   96
#define MODEL_WIDTH  32
#define MODEL_HEIGHT 32
#define SCALE_FACTOR (CAM_WIDTH / MODEL_WIDTH)

#define NUM_CLASSES 10 // CIFAR-10 has 10 classes
#define SCORE_THRESHOLD 90

#define FRAME_RGB565_BYTES ((CAM_WIDTH) * (CAM_HEIGHT) * 2)

static const char * const cifar10_labels[] = {
    "airplane", "automobile", "bird", "cat", "deer",
    "dog", "frog", "horse", "ship", "truck"
};

static uint16_t cam_frame_buf[CAM_WIDTH * CAM_HEIGHT]; /* rå RGB565, hele kamerabildet */
static int8_t lut_8bit[256];

static int8_t input_buf[MODEL_WIDTH * MODEL_HEIGHT * 3];
static int8_t output_buf[NUM_CLASSES];

static const struct gpio_dt_spec led_capture = GPIO_DT_SPEC_GET(DT_ALIAS(led0), gpios);
static const struct gpio_dt_spec led_detection = GPIO_DT_SPEC_GET(DT_ALIAS(led1), gpios);

static void capture_timer_expiry(struct k_timer *timer);

static K_TIMER_DEFINE(capture_timer, capture_timer_expiry, NULL);
static K_SEM_DEFINE(capture_sem, 0, 1);

/* Fires every 500ms and signals the main loop to capture a new frame. */
static void capture_timer_expiry(struct k_timer *timer)
{
	k_sem_give(&capture_sem);
}

/* Configures a GPIO pin as an output and verifies it is ready. */
static int led_init(const struct gpio_dt_spec *spec)
{
	int err;

	if (!gpio_is_ready_dt(spec)) {
		LOG_ERR("GPIO %s is not ready", spec->port->name);
		return -ENODEV;
	}

	err = gpio_pin_configure_dt(spec, GPIO_OUTPUT_INACTIVE);
	if (err) {
		LOG_ERR("Failed to configure %s pin %u (err %d)", spec->port->name, spec->pin, err);
		return err;
	}

	return 0;
}

/* Downsamples the 96x96 RGB565 frame to 32x32 via 3x3 box averaging,
   then quantizes into the model input buffer (HWC layout, matching training data). */
static void downsample_and_quantize(void)
{
    for (size_t out_row = 0; out_row < MODEL_HEIGHT; out_row++) {
        for (size_t out_col = 0; out_col < MODEL_WIDTH; out_col++) {
            uint32_t r_sum = 0, g_sum = 0, b_sum = 0;

            for (size_t dy = 0; dy < SCALE_FACTOR; dy++) {
                for (size_t dx = 0; dx < SCALE_FACTOR; dx++) {
                    const size_t cam_row = out_row * SCALE_FACTOR + dy;
                    const size_t cam_col = out_col * SCALE_FACTOR + dx;
                    const uint16_t pixel = cam_frame_buf[cam_row * CAM_WIDTH + cam_col];

                    /* Expand RGB565 to 8-bit-per-channel before averaging */
                    r_sum += ((pixel >> 11) & 0x1f) << 3;
                    g_sum += ((pixel >> 5)  & 0x3f) << 2;
                    b_sum += (pixel & 0x1f) << 3;
                }
            }

            const size_t n = SCALE_FACTOR * SCALE_FACTOR;
            const uint8_t r_avg = (uint8_t)(r_sum / n);
            const uint8_t g_avg = (uint8_t)(g_sum / n);
            const uint8_t b_avg = (uint8_t)(b_sum / n);

            /* HWC layout: interleaved per pixel, matching training data (NHWC) */
            const size_t dst = (out_row * MODEL_WIDTH + out_col) * 3;

            input_buf[dst + 0] = lut_8bit[r_avg];
            input_buf[dst + 1] = lut_8bit[g_avg];
            input_buf[dst + 2] = lut_8bit[b_avg];
        }
    }
}

/* Converts a raw 0-255 pixel intensity to a quantized int8 using the model's scale and zero-point. */
static inline int8_t quantize(const float value, const nrf_axon_nn_compiled_model_input_s *in)
{
	const uint32_t quant_mult = in->quant_mult;
	const uint8_t quant_round = in->quant_round;
	const int8_t quant_zp = in->quant_zp;

	const float scale = (float)quant_mult / (float)(1 << quant_round);
	const int32_t quantized = (int32_t)(value * scale) + quant_zp;

	return (int8_t)__ssat(quantized, 8);
}

/* Precomputes a quantized int8 lookup table for raw 8-bit pixel intensities (0-255),
   shared across R/G/B channels. */
static void prefill_luts(const nrf_axon_nn_compiled_model_input_s *in)
{
    for (int i = 0; i < 256; i++) {
        lut_8bit[i] = quantize((float)i, in);
    }
}

/* Reads one big-endian RGB565 pixel from a byte buffer at the given pixel index. */
static inline uint16_t extract_pixel(const uint8_t *data, const size_t pixel)
{
	const size_t offset = pixel * 2;

	return (uint16_t)((uint16_t)data[offset] << 8 | data[offset + 1]);
}

/* Copies a chunk of raw RGB565 pixels from the video buffer into the full-frame buffer. */
static void convert_chunk_to_cam_buf(const uint8_t *chunk_buf, size_t pixel_start, size_t pixel_count)
{
    for (size_t p = 0; p < pixel_count; p++) {
        cam_frame_buf[pixel_start + p] = extract_pixel(chunk_buf, p);
    }
}

/* Streams and reassembles a full RGB565 frame from the camera into cam_frame_buf. */
static int capture_one_frame(const struct device *video)
{
	size_t total = 0;

	while (total < FRAME_RGB565_BYTES) {
		struct video_buffer *vbuf;
		int err = video_dequeue(video, &vbuf, K_FOREVER);

		if (err == -EAGAIN) {
			continue;
		}
		if (err) {
			LOG_ERR("video_dequeue failed: %d", err);
			return err;
		}

		const size_t room = FRAME_RGB565_BYTES - total;
		const size_t chunk = min(vbuf->bytesused, room);

        convert_chunk_to_cam_buf(vbuf->buffer, total / 2, chunk / 2);
		
        total += chunk;

		vbuf->type = VIDEO_BUF_TYPE_OUTPUT;
		video_enqueue(video, vbuf);
	}

	return 0;
}


/* Captures one frame, runs inference, and toggles LEDs and logs based on detections. */
static int capture_and_detect(const struct device *video, const nrf_axon_nn_compiled_model_s *model)
{
	int err;
	nrf_axon_result_e result;

	(void)gpio_pin_toggle_dt(&led_capture);

	err = video_stream_start(video, VIDEO_BUF_TYPE_OUTPUT);
	if (err) {
		LOG_ERR("Failed to start stream (err %d)", err);
		return -1;
	}

	err = capture_one_frame(video);
	if (err) {
		LOG_ERR("Failed to capture frame (err %d)", err);
		(void)video_stream_stop(video, VIDEO_BUF_TYPE_OUTPUT);
		return -1;
	}

    downsample_and_quantize(); 

	err = video_stream_stop(video, VIDEO_BUF_TYPE_OUTPUT);
	if (err) {
		LOG_ERR("Failed to stop stream (err %d)", err);
		return -1;
	}

	result = nrf_axon_nn_model_infer_sync(model, input_buf, output_buf);
	if (result != NRF_AXON_RESULT_SUCCESS) {
		LOG_ERR("Inference failed (result %d)", result);
		(void)gpio_pin_set_dt(&led_detection, 0);
		return -1;
	}

	/* Print inference results*/
	for (int i = 0; i < NUM_CLASSES; i++) {
		LOG_INF("Class %s: score %d", cifar10_labels[i], output_buf[i]);
	}

	return 0;
}

/* Initialises camera, LEDs, Axon platform and model, then runs cifar10 classification every 500ms. */
int main(void)
{
	int err;

	nrf_axon_result_e result;
	const nrf_axon_nn_compiled_model_s *model = &model_cifar10_model;
	const nrf_axon_nn_compiled_model_input_s *model_inputs = nrf_axon_nn_model_1st_external_input(model);

	const struct device *video = DEVICE_DT_GET(DT_NODELABEL(arducam_mega));
	struct video_buffer *vbufs[2];
	struct video_format fmt = {.type = VIDEO_BUF_TYPE_INPUT,
				   .pixelformat = VIDEO_PIX_FMT_RGB565,
				   .width = CAM_WIDTH,
				   .height = CAM_HEIGHT,
				   .pitch = CAM_WIDTH * 2};
	
	if (led_init(&led_capture) != 0) {
		return -1;
	}
	if (led_init(&led_detection) != 0) {
		return -1;
	}

	if (!device_is_ready(video)) {
		LOG_ERR("Video device not ready");
		return -1;
	}

	err = video_set_format(video, &fmt);
	if (err) {
		LOG_ERR("Setting video format failed (err %d)", err);
		return -1;
	}

	for (size_t i = 0; i < ARRAY_SIZE(vbufs); i++) {
		vbufs[i] = video_buffer_alloc(1024, K_NO_WAIT);
		if (vbufs[i] == NULL) {
			LOG_ERR("Allocation failed for video buffer %u", i);
			return -1;
		}
		vbufs[i]->type = VIDEO_BUF_TYPE_OUTPUT;
		video_enqueue(video, vbufs[i]);
	}

	result = nrf_axon_platform_init();
	if (result != NRF_AXON_RESULT_SUCCESS) {
		LOG_ERR("Axon platform init failed (result %d)", result);
		return -1;
	}

	result = nrf_axon_nn_model_validate(model);
	if (result != NRF_AXON_RESULT_SUCCESS) {
		LOG_ERR("Model validation failed (result %d)", result);
		return -1;
	}

	prefill_luts(model_inputs);

	LOG_INF("Cifar 10 start");

	k_timer_start(&capture_timer, K_NO_WAIT, K_MSEC(500));

	while (true) {
		err = k_sem_take(&capture_sem, K_FOREVER);
		if (err) {
			continue;
		}

		err = capture_and_detect(video, model);
		if (err) {
			return -1;
		}
	}

	return 0;
}
```
